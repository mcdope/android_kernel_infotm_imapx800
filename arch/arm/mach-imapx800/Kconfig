## arch/arm/mach-imapx800/Kconfig
```kconfig
#arch/arm/mach-imapx200/Kconfig
# Copyright (c) 2009~2014 ShangHai Infotm Ltd all rights reserved. 
# Use of Infotm's code is governed by terms and conditions
# stated in the accompanying licensing statement. 
# Author:
#     ALex Zhang   <tao_zhang@infotm.com>
# Revision History: 
# ----------------
# 1.1  16/09/2009  Alex Zhang   

menu "IMAPX800 Machines"

config MACH_IMAPX800
	bool "IMAPX800"
	select CPU_IMAPX800
	help
	  Say Y here if you are using the IMAPX800

endmenu

config CPU_IMAPX800
	bool
	depends on ARCH_IMAPX800
	help
	  Support for IMAPX800 Infotm Mobile CPU based systems.


config IMAPX800_FPGA_PLATFORM
	bool "imapx800 fpga test"
	depends on ARCH_IMAPX800
	default n
	help 
	   If you are operating on the FPGA platform, set Y here!

config FPGA_CPU_CLK
	int "FPGA cpu clock configure"
	depends on IMAPX800_FPGA_PLATFORM
	default "40000000"

config FPGA_EXTEND_CLK
	int "FPGA externel clock configure"
	depends on IMAPX800_FPGA_PLATFORM
	default "40000000"

config IMAPX800_DMA
	bool
	depends on ARCH_IMAPX800
	select PL330
	default y
	help
	imapx800 dma enable

config  FAKE_PM
        bool "Support for fake power manage"
        depends on ARCH_IMAPX800
        default n
```

## drivers/InfotmMedia/Kconfig
```kconfig
#
# Multimedia device configuration
#

menuconfig INFOTM_MEDIA_SUPPORT
	bool "Infotm Media driver support"
	default y
	help
		InfotmMedia driver support

if INFOTM_MEDIA_SUPPORT

#
# g2d_drv_i800
#
source "drivers/InfotmMedia/external/project/g2d_drv_i800/Kconfig"

#
# isp_drv_i800
#
source "drivers/InfotmMedia/external/project/isp_drv_i800/Kconfig"

#
# camif_drv_i800
#
source "drivers/InfotmMedia/external/project/camif_drv_i800/Kconfig"

#
# ids_drv_i800
#
source "drivers/InfotmMedia/external/project/ids_drv_i800/Kconfig"

#
# vdec_drv_g1
#
source "drivers/InfotmMedia/external/project/vdec_drv_g1/Kconfig"

#
# venc_drv_8270
#
source "drivers/InfotmMedia/external/project/venc_drv_8270/Kconfig"

#
# pmm_drv_i800
#
source "drivers/InfotmMedia/external/project/pmm_drv_i800/Kconfig"

#
# ipc_drv
#
source "drivers/InfotmMedia/external/project/ipc_drv/Kconfig"

#
# utlz_drv
#
source "drivers/InfotmMedia/external/project/utlz_drv/Kconfig"

#
# dbt_drv
#
source "drivers/InfotmMedia/external/project/dbt_drv/Kconfig"

endif # INFOTM_MEDIA_SUPPORT
```

## drivers/InfotmMedia/external/project/camif_drv_i800/Kconfig
```kconfig
#
# Kconfig InfotmMedia g2d i800 driver.
#
# Copyright (c) 2009~2014 ShangHai Infotm Ltd all rights reserved.
#
#

menuconfig INFOTM_MEDIA_CAMIF_I800_SUPPORT
        bool "InfotmMedia CAMIF-i800 driver support"
        default y
        ---help---
		CAMIF-i800 driver.
```

## drivers/InfotmMedia/external/project/dbt_drv/Kconfig
```kconfig
#
# Kconfig InfotmMedia ipc driver.
#
# Copyright (c) 2009~2014 ShangHai Infotm Ltd all rights reserved.
#
#

menuconfig INFOTM_MEDIA_DBT_SUPPORT
        bool "InfotmMedia DBT driver support"
        default y
        ---help---
		dbt driver support
```

## drivers/InfotmMedia/external/project/g2d_drv_i800/Kconfig
```kconfig
#
# Kconfig InfotmMedia g2d i800 driver.
#
# Copyright (c) 2009~2014 ShangHai Infotm Ltd all rights reserved.
#
#

menuconfig INFOTM_MEDIA_G2D_I800_SUPPORT
        bool "InfotmMedia G2D-i800 driver support"
        default y
        ---help---
		G2D-i800 driver.
```

## drivers/InfotmMedia/external/project/ids_drv_i800/Kconfig
```kconfig
#
# Kconfig InfotmMedia ids i800 driver.
#
# Copyright (c) 2009~2014 ShangHai Infotm Ltd all rights reserved.
#
#

menuconfig INFOTM_MEDIA_IDS_I800_SUPPORT
        bool "InfotmMedia ids-i800 driver support"
        default y
        ---help---
		ids-i800 driver support

if INFOTM_MEDIA_IDS_I800_SUPPORT

config IDSDRV_EARLY_SUSPEND
	bool "use early suspend"
	depends on INFOTM_MEDIA_IDS_I800_SUPPORT
	default y

endif   # INFOTM_MEDIA_IDS_I800_SUPPORT
```

## drivers/InfotmMedia/external/project/ipc_drv/Kconfig
```kconfig
#
# Kconfig InfotmMedia ipc driver.
#
# Copyright (c) 2009~2014 ShangHai Infotm Ltd all rights reserved.
#
#

menuconfig INFOTM_MEDIA_IPC_SUPPORT
        bool "InfotmMedia IPC driver support"
        default y
        ---help---
		IPC driver support
```

## drivers/InfotmMedia/external/project/isp_drv_i800/Kconfig
```kconfig
#
# Kconfig InfotmMedia g2d i800 driver.
#
# Copyright (c) 2009~2014 ShangHai Infotm Ltd all rights reserved.
#
#

menuconfig INFOTM_MEDIA_ISP_I800_SUPPORT
        bool "InfotmMedia ISP-i800 driver support"
        default y
        ---help---
		ISP-i800 driver.
```

## drivers/InfotmMedia/external/project/pmm_drv_i800/Kconfig
```kconfig
#
# Kconfig InfotmMedia pmm driver.
#
# Copyright (c) 2009~2014 ShangHai Infotm Ltd all rights reserved.
#
#

menuconfig INFOTM_MEDIA_PMM_I800_SUPPORT
        bool "InfotmMedia pmm&dmmu_i800 driver support"
        default y
        ---help---
		pmm&dmmu driver.

if INFOTM_MEDIA_PMM_I800_SUPPORT
config PMM_RESERVE_MEM_SIZE_MB
	int "reserve memory for PMM to allocate physical-linear buffer"
	depends on INFOTM_MEDIA_PMM_I800_SUPPORT
	default 64

endif	#INFOTM_MEDIA_PMM_I800_SUPPORT
```

## drivers/InfotmMedia/external/project/utlz_drv/Kconfig
```kconfig
#
# Kconfig InfotmMedia utilization statistic driver.
#
# Copyright (c) 2009~2014 ShangHai Infotm Ltd all rights reserved.
#
#

menuconfig INFOTM_MEDIA_UTLZ_SUPPORT
        bool "InfotmMedia utilization statistic driver support"
        default y
        ---help---
		utilizaiton statistic driver support
```

## drivers/crypto/imapx/Kconfig
```kconfig
config CRYPTO_DEV_IMAPX
	tristate "imapx crypto"
	depends on ARCH_IMAPX800
	help
            for imapx cryto driver (imapx820)
```

## drivers/gps/Kconfig
```kconfig
menuconfig IMAP_GPS_HW
    tristate "imapx800 gps"
	default n
	depends on ARCH_IMAPX800
	help
	    for imapx800 gps driver


if IMAP_GPS_HW

config INFOTM_GPS
    tristate "Driver for imapx800 gps"
	help

endif
```

## drivers/i2c/chips/Kconfig
```kconfig
menu "Miscellaneous I2C Chip support"

config BOSCH_BMA150
	tristate "SMB380/BMA150 acceleration sensor support"
	depends on I2C=y
	help
	If you say yes here you get support for Bosch Sensortec's
	acceleration sensors SMB380/BMA150.

config BOSCH_DMARD08
	tristate "DMARD08 acceleration sensor susport"
	depends on I2C=y
	help
	If you say yes here you get support for Bosch Sensortec
	acceleration sensors DMARD08.

config BOSCH_DMT06
	tristate "DMT06 acceleration sensor susport"
	depends on I2C=y
	help
	If you say yes here you get support for Bosch Sensortec
	acceleration sensors DMT06.

config BOSCH_AFA750
	tristate "AFA750 acceleration sensor susport"
	depends on I2C=y
	help
	If you say yes here you get support for Bosch Sensortec
	acceleration sensors afa750.

config BOSCH_MC32X0
	tristate "mc32x0 acceleration sensor susport"
	depends on I2C=y
	help
	If you say yes here you get support for Bosch Sensortec
	acceleration sensors mc32x0.

config BOSCH_STK831X
	tristate "stk831x acceleration sensor susport"
	depends on I2C=y
	help
	If you say yes here you get support for Bosch Sensortec
	acceleration sensors stk831x.

config BOSCH_LSM303DLHC_ACC
    tristate "BOSCH_LSM303DLHC_ACC acceleration sensor susport"
    depends on I2C=y
    help
    If you say yes here you get support for Bosch Sensortec
    acceleration sensors LSM303DLHC_ACC.

config BOSCH_LSM303DLHC_MAG
    tristate "BOSCH_LSM303DLHC_MAG acceleration sensor susport"
    depends on I2C=y
    help
    If you say yes here you get support for Bosch Sensortec
    acceleration sensors LSM303DLHC_MAG.

config  CHARGER_BQ
	tristate "bq2415x charger  support"
	depends on I2C=y
	help
	If you say yes here you get support for bq2415x charger
	acceleration sensors SMB380/BMA150.
	
config FSL_MMA7660
	tristate " Freescale MMA7660 acceleration sensor susport"
	depends on I2C=y
	help
	If you say yes here you get support for Freescale's
	acceleration sensors MMA7660.
config FSL_MMA845X
	tristate " Freescale MMA845X acceleration sensor susport"
	depends on I2C=y
	help
	If you say yes here you get support for Freescale's
	acceleration sensors MMA845X.
		
endmenu
```

## drivers/infotm/Kconfig
```kconfig
#
# DSP subsystem configuration
#

menuconfig INFOTM_SPECIAL
	bool "InfoTM special files and drivers"
	default n
	help
	  InfoTM special files and drivers support

if INFOTM_SPECIAL

source "drivers/infotm/dsp/Kconfig"
source "drivers/infotm/items/Kconfig"
source "drivers/infotm/uboot/Kconfig"
source "drivers/infotm/led/Kconfig"

endif
```

## drivers/infotm/led/Kconfig
```kconfig
#
# Kconfig of led.
#
# Copyright 2012 InfoTM, all rights reserved.
#
# Sololz <sololz.luo@gmail.com> or <sololz.luo@infotmic.com.cn>.
#

menuconfig IMAPX_LED
        bool "LED support"
        depends on ARCH_IMAPX800
        default n

if IMAPX_LED

config LED_WORKING_PIN
        int "Working LED pin"
        default "-1"

config LED_SUSPEND_PIN
        int "Suspend LED pin"
        default "-1"

config IMAPX_LED_DEBUG
        bool "Print led debug messages"
        default n

endif
```

## drivers/infotm/uboot/Kconfig
```kconfig
#
# Modules base on InfoTM DSP
#

config IMAP_BOARD_UBOOT
	tristate "board configuration UBOOT"
	default y
	help
	  Say Y to enabled customer image backup tools(IBU).
```

## drivers/media/imapx/camera/Kconfig
```kconfig
#
# Kconfig IMAPX camera driver.
#
# Copyright (c) 2009~2014 ShangHai Infotm Ltd all rights reserved.
#
# Sololz<sololz.luo@gmail.com>.
#

menuconfig IMAPX_MULTIMEDIA_CAMERA_SUPPORT
	bool "Camera driver based on IMAPX platform(new version)"
	depends on MACH_IMAPX200
	default y
	---help---
	New version of camera driver in kernel space, pre version is 
	written and preserved by Petter Fu.

if IMAPX_MULTIMEDIA_CAMERA_SUPPORT

config IMAPX_CAMERA_DEBUG_ENABLE
	bool "Enable camera driver debug message print"
	default n

endif	# IMAPX_MULTIMEDIA_CAMERA_SUPPORT
```

## drivers/mtd/infotm/Kconfig
```kconfig
config MTD_INFOTM_NAND
	bool "InfoTMIC separate NAND system support"
	depends on MTD
	help
	  This enables support for accessing all type of NAND flash
	  devices. For further information see
	  <http://www.linux-mtd.infradead.org/doc/nand.html>.

choice
	prompt "NAND transfer method"
	depends on MTD_INFOTM_NAND

config MTD_NAND_IMAPX800_POLL
    bool "CPU polling"
	depends on MTD_INFOTM_NAND

config MTD_NAND_IMAPX800_SDMA
    bool "Simple DMA transfer"
	depends on MTD_INFOTM_NAND
endchoice	

config MTD_NAND_IMAPX800_SECC
    bool "use secc mode"
    depends on MTD
```

## drivers/pcb_test/Kconfig
```kconfig
#
# Kconfig of soops char device driver.
#
# InfoTM all rights reserved.
#
# Sololz <sololz.luo@gmail.com>.
#

menuconfig PCB_TEST
	bool "pcb test"
	default n
	---help---
	First I design this driver to implement Capslock key communication with
	application.

if PCB_TEST

config PCBTEST_DEBUG
	bool "Debug message print for pcb test"
	depends on PCB_TEST
	default n

endif	# PCB_TEST
```

## drivers/video/infotm/Kconfig
```kconfig
#
# IMAP Video Configuration
#

menuconfig FB_IMAP
	tristate "IMAP Framebuffer Support"
	select FB_CFB_FILLRECT
	select FB_CFB_COPYAREA
	select FB_CFB_IMAGEBLIT
	select FRAMEBUFFER_CONSOLE
	select LOGO
	select LOGO_LINUX_LANDSCAPED_CLUT224
	depends on FB && ARCH_IMAPX800
	default y
	---help---
	TBA

config FB_IMAP_NUM
	int "Number of Framebuffers"
	depends on FB_IMAP
	default "1"
	---help---
	TBA

config FB_IMAP_BUFFER_NUM
	int "Number of buffers for Framebuffer"
	depends on FB_IMAP
	default "4"
	---help---
	TBA
```

## drivers/video/logo/Kconfig
```kconfig
#
# Logo configuration
#

menuconfig LOGO
	bool "Bootup logo"
	depends on FB || SGI_NEWPORT_CONSOLE
	help
	  Enable and select frame buffer bootup logos.

if LOGO

menuconfig IG_OEM_LOGO
	bool "enable kernel logo"
	default y

if IG_OEM_LOGO

choice
prompt "choose logo"
config IG_LOGO_DEFAULT
	bool "default litte fat pungin"
	select LOGO_LINUX_CLUT224
config IG_LOGO_ALT
	bool "use an alternate OEM logo"
	help
	  We use imagemagick tools to generate an OEM logo.
	  Install the imagemagick pakage before you choose this option.
	  You can use the following command line to get this software:
	   $ sudo apt-get install imagemagick
	  
	  When this tool is ready, you can compile any picture as
	  your kernel logo. Simply put your picture into
	  drivers/video/infotm/logos/. and complete the path. This
	  is an easy way to create logo. You need not mind the format
	  of the picture. You also need not mind the size of the
	  picture, even if it is larger than your LCD screen.

	  Try it! Good luck :)
endchoice

config IG_LOGO_PATH
	string "choose a picture"
	depends on IG_LOGO_ALT
	default "bird.jpg"
	help
	  Input the picture name here. If you want to add a new picture,
	  you must put it to drivers/video/infotm/logos/.

endif

config FB_LOGO_EXTRA
	bool
	depends on FB=y
	default y if SPU_BASE

config LOGO_LINUX_MONO
	bool "Standard black and white Linux logo"
	depends on IG_LOGO_DEFAULT
	default y

config LOGO_LINUX_VGA16
	bool "Standard 16-color Linux logo"
	depends on IG_LOGO_DEFAULT
	default y

config LOGO_LINUX_CLUT224
	bool "Standard 224-color Linux logo"
	depends on IG_LOGO_DEFAULT
	default y

config LOGO_BLACKFIN_VGA16
	bool "16-colour Blackfin Processor Linux logo"
	depends on BLACKFIN
	default y

config LOGO_BLACKFIN_CLUT224
	bool "224-colour Blackfin Processor Linux logo"
	depends on BLACKFIN
	default y

config LOGO_DEC_CLUT224
	bool "224-color Digital Equipment Corporation Linux logo"
	depends on MACH_DECSTATION || ALPHA
	default y

config LOGO_MAC_CLUT224
	bool "224-color Macintosh Linux logo"
	depends on MAC
	default y

config LOGO_PARISC_CLUT224
	bool "224-color PA-RISC Linux logo"
	depends on PARISC
	default y

config LOGO_SGI_CLUT224
	bool "224-color SGI Linux logo"
	depends on SGI_IP22 || SGI_IP27 || SGI_IP32 || X86_VISWS
	default y

config LOGO_SUN_CLUT224
	bool "224-color Sun Linux logo"
	depends on SPARC
	default y

config LOGO_SUPERH_MONO
	bool "Black and white SuperH Linux logo"
	depends on SUPERH
	default y

config LOGO_SUPERH_VGA16
	bool "16-color SuperH Linux logo"
	depends on SUPERH
	default y

config LOGO_SUPERH_CLUT224
	bool "224-color SuperH Linux logo"
	depends on SUPERH
	default y

config LOGO_M32R_CLUT224
	bool "224-color M32R Linux logo"
	depends on M32R
	default y

endif # LOGO
```
